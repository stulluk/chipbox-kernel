## arch/arm/mach-orion/Kconfig
```kconfig
choice
        prompt "ORION Series SoC Version"
	depends on ARCH_CELESTIAL_ORION
        default ARCH_ORION_CSM1200

config ARCH_ORION_CSM1100
        bool "CSM1100 SoC"
	help
	  CSM1100 is the MPEG2-based DTV SoC from
          Celestial Semiconductor.

config ARCH_ORION_CSM1200
        bool "CSM1200 SoC"
	help 
	  CSM1200 is the MPEG2/H.264 IPTV/DTV SoC
          from Celestial Semiconductor.
config ARCH_ORION_CSM1200_J
        bool "CSM1200J SoC for SD"
        depends on ARCH_ORION_CSM1200
        default n
    help 
	  CSM1200J is the MPEG2/H.264 IPTV/DTV SoC for SD Video
          from Celestial Semiconductor.

config ARCH_ORION_CSM1201
        bool "CSM1201 SoC"
	help 
	  CSM1201 is the MPEG2/H.264 IPTV/DTV SoC
          from Celestial Semiconductor.
config ARCH_ORION_CSM1201_J
        bool "CSM1201J SoC for SD"
        depends on ARCH_ORION_CSM1201
        default n
    help 
	  CSM1201J is the MPEG2/H.264 IPTV/DTV SoC for SD Video
          from Celestial Semiconductor.
endchoice
```

## drivers/char/audio/Kconfig
```kconfig
#
# TPM device configuration
#

menu "Orion1.4 Audio devices"

config AUDIO_SUPPORT
	tristate "AUDIO Support"
	---help---
	  Orion1.4 audio function suport.

endmenu
```

## drivers/char/orion_df/Kconfig
```kconfig
#
# Character device configuration
#

menu "CSM1201 DF driver"

config ORION_DF
	tristate "ORION platform DF driver"
	depends on ARCH_ORION_CSM1201
				
config KERNEL_DF_DEBUG
	bool "DF Debugging"
        depends on ORION_DF
	help
	  This turns on low-level debugging for the ORION DF driver.
	  Normally, you should say 'N'.

endmenu
```

## drivers/char/orion_i2c/Kconfig
```kconfig
#
# Character device configuration
# Author: Sun He <he.sun@celestialsemi.cn>
#

menu "ORION I2C driver"

config ORION_I2C
       tristate "ORION platform I2C driver"

config ORION_I2C_1200
       tristate "ORION platform I2C driver for CSM1200"
       depends on ARCH_ORION_CSM1200 && ORION_I2C

config ORION_I2C_1201
       tristate "ORION platform I2C driver for CSM1201"
       depends on ARCH_ORION_CSM1201 && ORION_I2C

config ORION_I2C_DEBUG
	bool "I2C Debugging"
        depends on ORION_I2C
	help
	  This turns on low-level debugging for the ORION I2C driver.
	  Normally, you should say 'N'.


config I2C_DEBUG_VERBOSE
	int "Debugging verbosity (0 = quiet, 3 = noisy)"
	depends on ORION_I2C_DEBUG
	default "0"
	help
	  Determines the verbosity level of the I2C debugging messages.

config ORION_I2C_FASTSPEED
       bool "Support I2C fastspeed (400KHZ)"
       depends on ORION_I2C
       help
         If all on-board I2C device support fastspeed, say Y here, otherwise
         say N.

config ORION_I2C_EEPROM
       bool "Support I2C EEPROM"
        depends on ORION_I2C
       help
         Seperate EEPROM kernel device driver. Although I2C EEPROM can be accessed
	 though I2C device driver, this driver provides a simple read/write interface
         for application.

config ORION_I2C_EEPROM_CHIP_1_ADDR
       hex  "EEPROM i2c address"
       depends on ORION_I2C_EEPROM
       default 0x50

# ehnus BEGIN
config ORION_I2C_MULTI_EEPROMS
       bool "Support MULTI EEPROM on I2C"
       depends on ORION_I2C_EEPROM
       help
         Seperate EEPROM kernel device driver. For the second eeprom read/write.

config ORION_I2C_EEPROM_CHIP_2_ADDR
       hex  "Second EEPROM i2c address"
       depends on ORION_I2C_EEPROM && ORION_I2C_MULTI_EEPROMS
       default 0x54

config ORION_I2C_EEPROM_2_SUBADDR_LEN
       int  "Second EEPROM sub address length (in bytes)"
       depends on ORION_I2C_EEPROM && ORION_I2C_MULTI_EEPROMS
       default 2

config ORION_I2C_EEPROM_2_PAGE_SIZE
       int  "Second EEPROM page size (in bytes)"
       depends on ORION_I2C_EEPROM && ORION_I2C_MULTI_EEPROMS
       default 256

config ORION_I2C_EEPROM_2_SLEEP_TIME
       int  "Second EEPROM wait time after write (in milliseconds)."
       depends on ORION_I2C_EEPROM && ORION_I2C_MULTI_EEPROMS
       default 5
# ehnus END

config ORION_I2C_EEPROM_SUBADDR_LEN
       int  "EEPROM sub address length (in bytes)"
       depends on ORION_I2C_EEPROM
       default 2

config ORION_I2C_EEPROM_PAGE_SIZE
       int  "EEPROM page size (in bytes)"
       depends on ORION_I2C_EEPROM
       default 32

config ORION_I2C_EEPROM_SLEEP_TIME
       int  "EEPROM wait time after write (in milliseconds)."
       depends on ORION_I2C_EEPROM
       default 5

endmenu
```

## drivers/char/orion_spi/Kconfig
```kconfig
#
menu "Orion SPI devices"

config ORION_SPI
	depends on !MTD_SPIDEV
	tristate "ORION platform SPI driver"

config ORION_SPI_DEBUG
       	depends on ORION_SPI
	bool "Debug SPI driver!"

config SLAVE_SPEED
	hex "Slave Devices BAUD Rate"
       	depends on ORION_SPI
       	default 0x1
       	help
	  Default, 1024K
			0x0		500K
			0x1		1MH
			0x2		2MH
			0x3		3MH
			0x4		4MH
			0x5		5MH
choice
	prompt "Spi device choice"
	depends on ORION_SPI
	default SPI_COMMON

config SPI_COMMON
	bool "Support for interrupt based I/O operation"
config SFLASH
	bool "Support for serial flash"
endchoice

config FLASH_ALEN
       	hex  "Slave Device address length"
       	depends on ORION_SPI && SFLASH
       	default 0x3
	help
	  Slave bit width	

config FLASH_SIZE
       	hex  "Slave Device capacity"
       	depends on ORION_SPI && SFLASH
       	default 0x80000
	help
	  Slave bit width	

config SPI_FIP6311
	bool "spi fip6311 support"
	depends on ORION_SPI
	help
	  Spi fip6311 support

endmenu
```

## drivers/char/video/Kconfig
```kconfig
#
menu "CSM1200/CSM1201 A/V devices"

config VIDEO_SUPPORT
	tristate "Video decoder Support"

config TVE_SUPPORT
	tristate "TVE Support"
	depends on ARCH_ORION_CSM1200

endmenu
```

## drivers/char/xport/Kconfig
```kconfig
#
# TPM device configuration
#

menu "Orion1.4 Xport devices"

config XPORT_SUPPORT
	tristate "XPORT Support"
	---help---
	  Orion1.4 function suport.

config XPORT_BIG_DMABUFFER
       bool "Support Big DMA buffer for playing high bitrates streams."
       depends on XPORT_SUPPORT

config ORION_XPORT_DEBUG
	bool "Debugging"
	depends on XPORT_SUPPORT
	help
	  This turns on low-level debugging for the ORION XPORT driver.
	  Normally, you should say 'N'.


config XPORT_DEBUG_VERBOSE
	int "Debugging verbosity (0 = quiet, 3 = noisy)"
	depends on ORION_XPORT_DEBUG
	default "0"
	help
	  Determines the verbosity level of the XPORT debugging messages.

endmenu
```

## drivers/usb/musb/Kconfig
```kconfig
#
# INVENTRA USB Host Controller Drivers
#
# $Revision: 1.1.1.1 $
#
	  
config USB_INVENTRA_HCD
	depends on USB
	tristate 'MUSB Controller Support'
	help
	  Say Y here if you have the MUSB controller on your system.
	  If you do not know what this is, please say N.
	  To compile this driver as a module, choose M here.
	  
choice
prompt "Controller Mode"
depends on USB_INVENTRA_HCD 
default USB_INVENTRA_HCD_HOST

config USB_INVENTRA_HCD_HOST
	bool 'Host Mode'

endchoice

config USB_INVENTRA_STATIC_CONFIG
	depends on USB_INVENTRA_HCD
	bool 'Use static config (-DMUSB_STATIC_CONFIG)'
	default true
	help
	  Use the static configuration file. File must be called
	  hdrc_cnf.h and must be generated from the board configuration
	  file. Please check directory install/configs for examples.
	  If usure please say please say N and make sure your controller 
	  is not using dynamic FIFO sizing.

config USB_INVENTRA_DMA
	depends on USB_INVENTRA_HCD
	bool 'Use DMA when possible (-DMUSB_DMA)'
	default true
	help
	  Enable DMA transfers when DMA is possible

config	USB_INVENTRA_HCD_LOGGING
	depends on USB_INVENTRA_HCD
	int  'Logging Level (0 - none / 3 - annoying)'
	default 0 
	help
	  Set the logging level. 0 disable the debugging altogether (no 
	  code will be added to the)
          If you do not know what this is, please say N.	  
```
